## drivers/net/ethernet/spacemit/Kconfig
```kconfig
config NET_VENDOR_SPACEMIT
	bool "Spacemit devices"
	default y
	depends on SOC_SPACEMIT
	help
	  If you have a network (Ethernet) chipset belonging to this class,
	  say Y.

	  Note that the answer to this question does not directly affect
	  the kernel: saying N will just cause the configurator to skip all
	  the questions regarding Spacemit chipsets. If you say Y, you will
	  be asked for your specific chipset/driver in the following questions.

if NET_VENDOR_SPACEMIT

config K1X_EMAC
	bool "k1-x Emac Driver"
	depends on SOC_SPACEMIT_K1X
	select PHYLIB
	help
	  This Driver support Spacemit k1-x Ethernet MAC
	  Say Y to enable support for the Spacemit Ethernet.

config K1XMAC_UIO
	tristate "k1x Emac UIO ethernet controller"
	default n
	select UIO
	help
	  Say M here to build the k1x EMAC UIO driver for DPDK or other
	  serspace network applications.

	  This driver exports the Ethernet controller's registers and DMA
	  descriptor rings to userspace via the UIO framework. It does not
	  use the kernel network stack and is intended for use with DPDK
	  PMD drivers.

	  If you want to use the k1x EMAC hardware with DPDK, enable this
	  driver. If unsure, say N.

	  The module will be called k1xmac_uio.ko.

endif # NET_VENDOR_SPACEMIT
```

## drivers/net/wireless/realtek/rtl8821cs/Kconfig
```kconfig
# SPDX-License-Identifier: GPL-2.0
config RTL8821CS
	tristate "Realtek 8821C SDIO Wireless driver"
	depends on WLAN && MMC && CFG80211
	help
	  This option enables support for RTL8821CS SDIO drivers
```
